/ {
	chosen {
		zephyr,console = &usart2;
		zephyr,shell-uart = &usart2;
	};
};

&usart2 {
	pinctrl-0 = <&usart2_tx_pa2 &usart2_rx_pa3>;
	pinctrl-1 = <&analog_pa2 &analog_pa3>;
	pinctrl-names = "default", "sleep";
	current-speed = <115200>;
	status = "okay";
};