## drivers/pwm/Kconfig.stm32
```kconfig
# STM32 PWM configuration options

# Copyright (c) 2016 Linaro Limited.
# SPDX-License-Identifier: Apache-2.0

config PWM_STM32
	bool "STM32 MCU PWM driver"
	default y
	depends on DT_HAS_ST_STM32_PWM_ENABLED
	select USE_STM32_LL_TIM
	select USE_STM32_LL_RCC if SOC_SERIES_STM32F4X || SOC_SERIES_STM32F7X || SOC_SERIES_STM32H7X
	select RESET
	help
	  This option enables the PWM driver for STM32 family of
	  processors. Say y if you wish to use PWM port on STM32
	  MCU.

config PWM_STM32_EX
	bool "STM32 MCU PWM driver"
	default n
	depends on PWM_STM32
	help
	  This option enables extended API for STM32 PWM.
```

## dts/bindings/display/zephyr,sdl-dc.yaml
```yaml
# Copyright (c) 2021 Nordic Semiconductor ASA
# SPDX-License-Identifier: Apache-2.0

description: SDL based emulated display controller

compatible: "zephyr,sdl-dc"

properties:
  zoom_percent:
    type: int
    required: false
    default: 100
    description: |
      Zoom factor.

include: display-controller.yaml
```

## dts/bindings/serial/uart-stay-awake.yaml
```yaml
# Common fields for UART controllers

properties:
  stay-awake-time-ms:
    type: int
    default: 0
    description: |
      Time in milliseconds where the driver (and if needed, the system) 
      stays awake after receiving a falling edge on the rx pin.
      If 0, deactivate the stay awake mode.

  rx-gpios:
    type: phandle-array
    description: |
      GPIO to which the RX UART signal is routed.
      Used by the stay awake functionality.
```

## samples/subsys/settings/boards/nucleo_wl55jc.conf
```kconfig
CONFIG_NVS=y
CONFIG_SETTINGS_NVS=y
CONFIG_NVS_LOOKUP_CACHE=y
CONFIG_NVS_LOOKUP_CACHE_SIZE=256

CONFIG_PM=y
CONFIG_PM_DEVICE=y
CONFIG_PM_DEVICE_RUNTIME=y
CONFIG_PM_DEVICE_RUNTIME_EXCLUSIVE=n

CONFIG_FLASH=y
CONFIG_FLASH_MAP=y
CONFIG_SPI_NOR=y
CONFIG_SPI_NOR_SFDP_DEVICETREE=y
CONFIG_SPI_NOR_FLASH_LAYOUT_PAGE_SIZE=4096

CONFIG_LOG=y
CONFIG_LOG_MODE_IMMEDIATE=y

CONFIG_MAIN_STACK_SIZE=4096
```

## subsys/lorawan/services/Kconfig.clock_sync
```kconfig
config LORAWAN_APP_CLOCK_SYNC
	bool "Application Layer Clock Synchronization"
	help
	  Enables the LoRaWAN Application Layer Clock Synchronization service
	  according to LoRa Alliance TS003-2.0.0.

	  The service uses the default port 202.

if LORAWAN_APP_CLOCK_SYNC

config LORAWAN_APP_CLOCK_SYNC_PERIODICITY
	int "Application Layer Clock Synchronization periodicity"
	range 128 4194304
	default 86400
	help
	  Initial setting for clock synchronization periodicity in seconds.

	  The value can be updated remotely by the application server within a
	  range from 128 (0x80) to 4194304 (0x400000).

	  Default setting: 24h.

config LORAWAN_APP_CLOCK_NOT_SYNC_PERIODICITY
	int "Application Layer Clock Synchronization not synchronized periodicity"
	range 128 4194304
	default 128
	help
	  Initial setting for clock synchronization periodicity in seconds.

	  The value can be updated remotely by the application server within a
	  range from 128 (0x80) to 4194304 (0x400000).

	  Default setting: 2min.

endif # LORAWAN_APP_CLOCK_SYNC
```

## subsys/lorawan/services/Kconfig.frag_transport
```kconfig
config LORAWAN_FRAG_TRANSPORT
	bool "Fragmented Data Block Transport"
	help
	  Enables the LoRaWAN Fragmented Data Block Transport service
	  according to TS004 as published by the LoRa Alliance.

	  The version of the specification can be selected with
	  CONFIG_LORAWAN_FRAG_TRANSPORT_VERSION.

	  This service uses port 201.

if LORAWAN_FRAG_TRANSPORT


config LORAWAN_FRAG_TRANSPORT_VERSION
	int "Fragmented Data Block Transport Specification"
	range 1 2
	default 1
	help
	  The implementation considers different versions of the specification
	  released by the LoRa Alliance.

	  Select one of the following revisions:

	  1: TS004-1.0.0
	  2: TS004-2.0.0 (not fully supported, only for testing)

DT_CHOSEN_Z_CODE_PARTITION := zephyr,code-partition

config LORAWAN_FRAG_TRANSPORT_IMAGE_SIZE
	int "Total size of firmware image"
	default $(dt_chosen_reg_size_int,$(DT_CHOSEN_Z_CODE_PARTITION))
	help
	  Size of the flash partition for the application firmware image
	  in bytes.

	  The minimum number of fragments to be transferred is calculated from
	  this value divided by the fragment size.

	  This setting has significant influence on RAM usage.

config LORAWAN_FRAG_TRANSPORT_MAX_FRAG_SIZE
	int "Maximum size of transported fragments"
	range 1 239
	default 232
	help
	  Maximum size of one fragment transferred during the fragmented data
	  block transport session of the FUOTA process. It is chosen on the
	  server side.

	  The fragment has to fit into the LoRaWAN payload, which can be up to
	  242 bytes depending on the region and frequency settings. 3 bytes of
	  the payload are consumed for protocol information.

	  For some MCUs like the STM32WL the fragment size has to be a multiple
	  of 8 (see flash driver for further information).

	  This setting has significant influence on RAM usage. If the exact
	  fragment size is known, use that value for MIN and MAX config to
	  reduce memory consumption.

config LORAWAN_FRAG_TRANSPORT_MIN_FRAG_SIZE
	int "Minimum size of transported fragments"
	range 1 239
	default 48
	help
	  Minimum size of one fragment transferred during the fragmented data
	  block transport session of the FUOTA process. It is chosen on the
	  server side.

	  The fragment has to fit into the LoRaWAN payload, which can be up to
	  242 bytes depending on the region and frequency settings. 3 bytes of
	  the payload are consumed for protocol information.

	  For some MCUs like the STM32WL the fragment size has to be a multiple
	  of 8 (see flash driver for further information).

	  This setting has significant influence on RAM usage. If the exact
	  fragment size is known, use that value for MIN and MAX config to
	  reduce memory consumption.

config LORAWAN_FRAG_TRANSPORT_MAX_REDUNDANCY
	int "Percentage of redundant fragments"
	range 1 100
	default 10
	help
	  The built-in forward error correction (FEC) mechanism allows to
	  reconstruct missed packages from additional redundant packages
	  sent by the server after all packages have been sent.

	  This parameter specifies the maximum amount of packet loss (in
	  percent) for which it should be possible to reconstruct the full
	  firmware image.

	  This setting has significant influence on RAM usage.


endif # LORAWAN_FRAG_TRANSPORT
```

## subsys/lorawan/services/Kconfig.multicast
```kconfig
config LORAWAN_REMOTE_MULTICAST
	bool "Remote Multicast Setup"
	depends on LORAWAN_APP_CLOCK_SYNC
	depends on SETTINGS
	help
	  Enables the LoRaWAN Remote Multicast Setup service
	  according to TS005 as published by the LoRa Alliance.

	  The version of the specification can be selected with
	  CONFIG_LORAWAN_REMOTE_MULTICAST_VERSION.

	  The service uses the default port 200.

if LORAWAN_REMOTE_MULTICAST

config LORAWAN_REMOTE_MULTICAST_SESSIONS
	int "Number of possible Multicast Sessions"
	range 1 4
	default 1
	help
	  Choose how much multicast sessions the stack must handle

config LORAWAN_REMOTE_MULTICAST_VERSION
	int "Remote Multicast Setup Specification"
	range 1 2
	default 1
	help
	  The implementation considers different versions of the specification
	  released by the LoRa Alliance.

	  Select one of the following revisions:

	  1: TS005-1.0.0
	  2: TS005-2.0.0 (not fully supported, only for testing)

endif # LORAWAN_REMOTE_MULTICAST
```
